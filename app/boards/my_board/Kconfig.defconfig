## twister-out/native_sim_native/host_gnu/tests/ring_buf/homework.unit.ring_buf/Kconfig/soc/Kconfig.soc
```kconfig
# Load SoC Kconfig descriptions.
osource "/home/raul/zephyr-course/zephyr/soc/xlnx/zynqmp/Kconfig.soc"
osource "/home/raul/zephyr-course/zephyr/soc/xlnx/zynq7000/Kconfig.soc"
osource "/home/raul/zephyr-course/zephyr/soc/xlnx/versalnet/Kconfig.soc"
osource "/home/raul/zephyr-course/zephyr/soc/xlnx/versal2/Kconfig.soc"
osource "/home/raul/zephyr-course/zephyr/soc/xlnx/versal/Kconfig.soc"
osource "/home/raul/zephyr-course/zephyr/soc/xen/Kconfig.soc"
osource "/home/raul/zephyr-course/zephyr/soc/wch/ch32v/Kconfig.soc"
osource "/home/raul/zephyr-course/zephyr/soc/ti/tiva_c/Kconfig.soc"
osource "/home/raul/zephyr-course/zephyr/soc/ti/simplelink/Kconfig.soc"
osource "/home/raul/zephyr-course/zephyr/soc/ti/mspm/Kconfig.soc"
osource "/home/raul/zephyr-course/zephyr/soc/ti/lm3s6965/Kconfig.soc"
osource "/home/raul/zephyr-course/zephyr/soc/ti/k3/Kconfig.soc"
osource "/home/raul/zephyr-course/zephyr/soc/ti/am13/Kconfig.soc"
osource "/home/raul/zephyr-course/zephyr/soc/telink/tlsr/Kconfig.soc"
osource "/home/raul/zephyr-course/zephyr/soc/syna/sr100/Kconfig.soc"
osource "/home/raul/zephyr-course/zephyr/soc/starfive/jh71xx/Kconfig.soc"
osource "/home/raul/zephyr-course/zephyr/soc/st/stm32/Kconfig.soc"
osource "/home/raul/zephyr-course/zephyr/soc/snps/qemu_arc/Kconfig.soc"
osource "/home/raul/zephyr-course/zephyr/soc/snps/nsim/arc_v/Kconfig.soc"
osource "/home/raul/zephyr-course/zephyr/soc/snps/nsim/arc_classic/Kconfig.soc"
osource "/home/raul/zephyr-course/zephyr/soc/snps/hsdk4xd/Kconfig.soc"
osource "/home/raul/zephyr-course/zephyr/soc/snps/hsdk/Kconfig.soc"
osource "/home/raul/zephyr-course/zephyr/soc/snps/emsk/Kconfig.soc"
osource "/home/raul/zephyr-course/zephyr/soc/snps/emsdp/Kconfig.soc"
osource "/home/raul/zephyr-course/zephyr/soc/snps/arc_iot/Kconfig.soc"
osource "/home/raul/zephyr-course/zephyr/soc/silabs/Kconfig.soc"
osource "/home/raul/zephyr-course/zephyr/soc/sifli/sf32/Kconfig.soc"
osource "/home/raul/zephyr-course/zephyr/soc/sifive/sifive_freedom/Kconfig.soc"
osource "/home/raul/zephyr-course/zephyr/soc/shakti/Kconfig.soc"
osource "/home/raul/zephyr-course/zephyr/soc/sensry/Kconfig.soc"
osource "/home/raul/zephyr-course/zephyr/soc/rockchip/Kconfig.soc"
osource "/home/raul/zephyr-course/zephyr/soc/renode/riscv_virtual/Kconfig.soc"
osource "/home/raul/zephyr-course/zephyr/soc/renode/cortex_r8_virtual/Kconfig.soc"
osource "/home/raul/zephyr-course/zephyr/soc/renesas/smartbond/Kconfig.soc"
osource "/home/raul/zephyr-course/zephyr/soc/renesas/rz/Kconfig.soc"
osource "/home/raul/zephyr-course/zephyr/soc/renesas/rx/Kconfig.soc"
osource "/home/raul/zephyr-course/zephyr/soc/renesas/rcar/Kconfig.soc"
osource "/home/raul/zephyr-course/zephyr/soc/renesas/ra/Kconfig.soc"
osource "/home/raul/zephyr-course/zephyr/soc/realtek/fingerprint/Kconfig.soc"
osource "/home/raul/zephyr-course/zephyr/soc/realtek/ec/Kconfig.soc"
osource "/home/raul/zephyr-course/zephyr/soc/realtek/bee/Kconfig.soc"
osource "/home/raul/zephyr-course/zephyr/soc/realtek/ameba/Kconfig.soc"
osource "/home/raul/zephyr-course/zephyr/soc/raspberrypi/rpi_pico/Kconfig.soc"
osource "/home/raul/zephyr-course/zephyr/soc/quicklogic/eos_s3/Kconfig.soc"
osource "/home/raul/zephyr-course/zephyr/soc/qemu/virt_riscv/Kconfig.soc"
osource "/home/raul/zephyr-course/zephyr/soc/qemu/tricore/Kconfig.soc"
osource "/home/raul/zephyr-course/zephyr/soc/qemu/or1k/Kconfig.soc"
osource "/home/raul/zephyr-course/zephyr/soc/qemu/malta/Kconfig.soc"
osource "/home/raul/zephyr-course/zephyr/soc/qemu/hexagon/Kconfig.soc"
osource "/home/raul/zephyr-course/zephyr/soc/openisa/rv32m1/Kconfig.soc"
osource "/home/raul/zephyr-course/zephyr/soc/openhwgroup/erbium/Kconfig.soc"
osource "/home/raul/zephyr-course/zephyr/soc/openhwgroup/cva6/Kconfig.soc"
osource "/home/raul/zephyr-course/zephyr/soc/oct/osd32mp15x/Kconfig.soc"
osource "/home/raul/zephyr-course/zephyr/soc/nxp/s32/Kconfig.soc"
osource "/home/raul/zephyr-course/zephyr/soc/nxp/rw/Kconfig.soc"
osource "/home/raul/zephyr-course/zephyr/soc/nxp/mcx/Kconfig.soc"
osource "/home/raul/zephyr-course/zephyr/soc/nxp/lpc/Kconfig.soc"
osource "/home/raul/zephyr-course/zephyr/soc/nxp/layerscape/Kconfig.soc"
osource "/home/raul/zephyr-course/zephyr/soc/nxp/kinetis/Kconfig.soc"
osource "/home/raul/zephyr-course/zephyr/soc/nxp/imxrt/Kconfig.soc"
osource "/home/raul/zephyr-course/zephyr/soc/nxp/imx/Kconfig.soc"
osource "/home/raul/zephyr-course/zephyr/soc/nuvoton/numicro/Kconfig.soc"
osource "/home/raul/zephyr-course/zephyr/soc/nuvoton/numaker/Kconfig.soc"
osource "/home/raul/zephyr-course/zephyr/soc/nuvoton/npcx/Kconfig.soc"
osource "/home/raul/zephyr-course/zephyr/soc/nuvoton/npcm/Kconfig.soc"
osource "/home/raul/zephyr-course/zephyr/soc/nordic/Kconfig.soc"
osource "/home/raul/zephyr-course/zephyr/soc/neorv32/Kconfig.soc"
osource "/home/raul/zephyr-course/zephyr/soc/native/inf_clock/Kconfig.soc"
osource "/home/raul/zephyr-course/zephyr/soc/microchip/smartfusion2/Kconfig.soc"
osource "/home/raul/zephyr-course/zephyr/soc/microchip/sam/sama7/Kconfig.soc"
osource "/home/raul/zephyr-course/zephyr/soc/microchip/sam/sama5/Kconfig.soc"
osource "/home/raul/zephyr-course/zephyr/soc/microchip/sam/sam_d5x_e5x/Kconfig.soc"
osource "/home/raul/zephyr-course/zephyr/soc/microchip/pic64/Kconfig.soc"
osource "/home/raul/zephyr-course/zephyr/soc/microchip/pic32c/pic32cz_ca/Kconfig.soc"
osource "/home/raul/zephyr-course/zephyr/soc/microchip/pic32c/pic32cx_sg/Kconfig.soc"
osource "/home/raul/zephyr-course/zephyr/soc/microchip/pic32c/pic32cm_sg_gc/Kconfig.soc"
osource "/home/raul/zephyr-course/zephyr/soc/microchip/pic32c/pic32cm_pl/Kconfig.soc"
osource "/home/raul/zephyr-course/zephyr/soc/microchip/pic32c/pic32cm_jh/Kconfig.soc"
osource "/home/raul/zephyr-course/zephyr/soc/microchip/pic32c/pic32ck_sg_gc/Kconfig.soc"
osource "/home/raul/zephyr-course/zephyr/soc/microchip/miv/Kconfig.soc"
osource "/home/raul/zephyr-course/zephyr/soc/microchip/mec/Kconfig.soc"
osource "/home/raul/zephyr-course/zephyr/soc/mediatek/mt8xxx/Kconfig.soc"
osource "/home/raul/zephyr-course/zephyr/soc/lowrisc/opentitan/Kconfig.soc"
osource "/home/raul/zephyr-course/zephyr/soc/litex/Kconfig.soc"
osource "/home/raul/zephyr-course/zephyr/soc/ite/ec/Kconfig.soc"
osource "/home/raul/zephyr-course/zephyr/soc/intel/wildcat_lake/Kconfig.soc"
osource "/home/raul/zephyr-course/zephyr/soc/intel/raptor_lake/Kconfig.soc"
osource "/home/raul/zephyr-course/zephyr/soc/intel/panther_lake/Kconfig.soc"
osource "/home/raul/zephyr-course/zephyr/soc/intel/nova_lake/Kconfig.soc"
osource "/home/raul/zephyr-course/zephyr/soc/intel/lakemont/Kconfig.soc"
osource "/home/raul/zephyr-course/zephyr/soc/intel/intel_socfpga_std/Kconfig.soc"
osource "/home/raul/zephyr-course/zephyr/soc/intel/intel_socfpga/Kconfig.soc"
osource "/home/raul/zephyr-course/zephyr/soc/intel/intel_niosv/Kconfig.soc"
osource "/home/raul/zephyr-course/zephyr/soc/intel/intel_ish/Kconfig.soc"
osource "/home/raul/zephyr-course/zephyr/soc/intel/intel_adsp/Kconfig.soc"
osource "/home/raul/zephyr-course/zephyr/soc/intel/elkhart_lake/Kconfig.soc"
osource "/home/raul/zephyr-course/zephyr/soc/intel/atom/Kconfig.soc"
osource "/home/raul/zephyr-course/zephyr/soc/intel/apollo_lake/Kconfig.soc"
osource "/home/raul/zephyr-course/zephyr/soc/intel/alder_lake/Kconfig.soc"
osource "/home/raul/zephyr-course/zephyr/soc/infineon/psoc4/Kconfig.soc"
osource "/home/raul/zephyr-course/zephyr/soc/infineon/edge/Kconfig.soc"
osource "/home/raul/zephyr-course/zephyr/soc/infineon/cat3/Kconfig.soc"
osource "/home/raul/zephyr-course/zephyr/soc/infineon/cat1c/Kconfig.soc"
osource "/home/raul/zephyr-course/zephyr/soc/infineon/cat1b/Kconfig.soc"
osource "/home/raul/zephyr-course/zephyr/soc/infineon/cat1a/Kconfig.soc"
osource "/home/raul/zephyr-course/zephyr/soc/gd/gd32/Kconfig.soc"
osource "/home/raul/zephyr-course/zephyr/soc/gaisler/leon3/Kconfig.soc"
osource "/home/raul/zephyr-course/zephyr/soc/gaisler/gr716a/Kconfig.soc"
osource "/home/raul/zephyr-course/zephyr/soc/focaltech/Kconfig.soc"
osource "/home/raul/zephyr-course/zephyr/soc/espressif/Kconfig.soc"
osource "/home/raul/zephyr-course/zephyr/soc/ene/kb1200/Kconfig.soc"
osource "/home/raul/zephyr-course/zephyr/soc/ene/kb106x/Kconfig.soc"
osource "/home/raul/zephyr-course/zephyr/soc/elan/em32f967/Kconfig.soc"
osource "/home/raul/zephyr-course/zephyr/soc/egis/Kconfig.soc"
osource "/home/raul/zephyr-course/zephyr/soc/efinix/sapphire/Kconfig.soc"
osource "/home/raul/zephyr-course/zephyr/soc/cdns/xtensa_sample_controller/Kconfig.soc"
osource "/home/raul/zephyr-course/zephyr/soc/cdns/swerv/Kconfig.soc"
osource "/home/raul/zephyr-course/zephyr/soc/cdns/sample_controller32/Kconfig.soc"
osource "/home/raul/zephyr-course/zephyr/soc/cdns/dc233c/Kconfig.soc"
osource "/home/raul/zephyr-course/zephyr/soc/cdac/Kconfig.soc"
osource "/home/raul/zephyr-course/zephyr/soc/brcm/bcmvk/Kconfig.soc"
osource "/home/raul/zephyr-course/zephyr/soc/brcm/bcm2712/Kconfig.soc"
osource "/home/raul/zephyr-course/zephyr/soc/brcm/bcm2711/Kconfig.soc"
osource "/home/raul/zephyr-course/zephyr/soc/brcm/bcm2710/Kconfig.soc"
osource "/home/raul/zephyr-course/zephyr/soc/blackberry/qnxhv_vm/Kconfig.soc"
osource "/home/raul/zephyr-course/zephyr/soc/bflb/Kconfig.soc"
osource "/home/raul/zephyr-course/zephyr/soc/atmel/sam0/Kconfig.soc"
osource "/home/raul/zephyr-course/zephyr/soc/atmel/sam/Kconfig.soc"
osource "/home/raul/zephyr-course/zephyr/soc/aspeed/Kconfig.soc"
osource "/home/raul/zephyr-course/zephyr/soc/arm/Kconfig.soc"
osource "/home/raul/zephyr-course/zephyr/soc/antmicro/myra/Kconfig.soc"
osource "/home/raul/zephyr-course/zephyr/soc/andestech/Kconfig.soc"
osource "/home/raul/zephyr-course/zephyr/soc/amd/acp_7_x/Kconfig.soc"
osource "/home/raul/zephyr-course/zephyr/soc/amd/acp_7_0/Kconfig.soc"
osource "/home/raul/zephyr-course/zephyr/soc/amd/acp_6_0/Kconfig.soc"
osource "/home/raul/zephyr-course/zephyr/soc/ambiq/Kconfig.soc"
osource "/home/raul/zephyr-course/zephyr/soc/allwinner/sun8i_h3/Kconfig.soc"
osource "/home/raul/zephyr-course/zephyr/soc/allwinner/sun50i_h618/Kconfig.soc"
osource "/home/raul/zephyr-course/zephyr/soc/alif/ensemble/Kconfig.soc"
osource "/home/raul/zephyr-course/zephyr/soc/alif/balletto/Kconfig.soc"
osource "/home/raul/zephyr-course/zephyr/soc/aesc/Kconfig.soc"
osource "/home/raul/zephyr-course/zephyr/soc/adi/max32/Kconfig.soc"
```

## twister-out/qemu_x86_atom/zephyr_gnu/zephyr-course/tests/ring_buf/homework.unit.ring_buf/Kconfig/boards/Kconfig.defconfig
```kconfig
# Load Zephyr board defconfig descriptions.
osource "C:/IOMICO_Assigments/deps/zephyr/boards/qemu/x86/Kconfig.defconfig"
```

## twister-out/qemu_x86_atom/zephyr_gnu/zephyr-course/tests/ring_buf/homework.unit.ring_buf/Kconfig/boards/Kconfig.sysbuild
```kconfig
# Load Sysbuild board Kconfig descriptions.
osource "C:/IOMICO_Assigments/deps/zephyr/boards/qemu/x86/Kconfig.sysbuild"
```
