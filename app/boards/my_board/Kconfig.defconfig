## app/boards/my_board/Kconfig.my_board
```kconfig
config BOARD_MY_BOARD
	select SOC_MCXA156 if BOARD_MY_BOARD
	select SOC_PART_NUMBER_MCXA156VLL
```

## app/boards/our_board/board.yml
```yaml
board:
  name: our_board
  full_name: OUR Board
  vendor: iomico
  socs:
  - name: mcxa156
```

## tests/ring_buf/testcase.yaml
```yaml
common:
  tags:
    - unit
    - ring_buf
    - ztest
    - homework

tests:
  homework.unit.ring_buf:
    platform_allow: 
     - native_sim
     - qemu_x86
    timeout: 800
```

## twister-out.4/qemu_x86_atom/zephyr_gnu/zephyr-course/tests/ring_buf/homework.unit.ring_buf/Kconfig/Kconfig.modules
```kconfig
menu "cmsis_6 (C:/IOMICO_Assigments/deps/modules/hal/cmsis_6)"
osource "$(ZEPHYR_CMSIS_6_KCONFIG)"
config ZEPHYR_CMSIS_6_MODULE
	bool
	default y
endmenu
menu "hal_nxp (C:/IOMICO_Assigments/deps/modules/hal/nxp)"
osource "$(ZEPHYR_HAL_NXP_KCONFIG)"
config ZEPHYR_HAL_NXP_MODULE
	bool
	default y

config ZEPHYR_HAL_NXP_MODULE_BLOBS
	bool
endmenu
config ZEPHYR_HAL_STM32_MODULE
	bool
	default y

config ZEPHYR_HAL_STM32_MODULE_BLOBS
	bool
```

## twister-out.4/qemu_x86_atom/zephyr_gnu/zephyr-course/tests/ring_buf/homework.unit.ring_buf/Kconfig/arch/Kconfig
```kconfig
# Load Zephyr Arch Kconfig descriptions.
osource "C:/IOMICO_Assigments/deps/zephyr/arch/rx/Kconfig"
osource "C:/IOMICO_Assigments/deps/zephyr/arch/x86/Kconfig"
osource "C:/IOMICO_Assigments/deps/zephyr/arch/xtensa/Kconfig"
osource "C:/IOMICO_Assigments/deps/zephyr/arch/sparc/Kconfig"
osource "C:/IOMICO_Assigments/deps/zephyr/arch/riscv/Kconfig"
osource "C:/IOMICO_Assigments/deps/zephyr/arch/posix/Kconfig"
osource "C:/IOMICO_Assigments/deps/zephyr/arch/openrisc/Kconfig"
osource "C:/IOMICO_Assigments/deps/zephyr/arch/mips/Kconfig"
osource "C:/IOMICO_Assigments/deps/zephyr/arch/arm64/Kconfig"
osource "C:/IOMICO_Assigments/deps/zephyr/arch/arm/Kconfig"
osource "C:/IOMICO_Assigments/deps/zephyr/arch/arc/Kconfig"
```

## twister-out.4/qemu_x86_atom/zephyr_gnu/zephyr-course/tests/ring_buf/homework.unit.ring_buf/Kconfig/boards/Kconfig.qemu_x86.tmp
```kconfig
# Load board Kconfig descriptions.
osource "C:/IOMICO_Assigments/deps/zephyr/boards/qemu/x86/Kconfig.qemu_x86"
```

## twister-out/native_sim_native/host_gnu/tests/ring_buf/homework.unit.ring_buf/Kconfig/arch/Kconfig
```kconfig
# Load Zephyr Arch Kconfig descriptions.
osource "/home/raul/zephyr-course/zephyr/arch/tricore/Kconfig"
osource "/home/raul/zephyr-course/zephyr/arch/hexagon/Kconfig"
osource "/home/raul/zephyr-course/zephyr/arch/rx/Kconfig"
osource "/home/raul/zephyr-course/zephyr/arch/x86/Kconfig"
osource "/home/raul/zephyr-course/zephyr/arch/xtensa/Kconfig"
osource "/home/raul/zephyr-course/zephyr/arch/sparc/Kconfig"
osource "/home/raul/zephyr-course/zephyr/arch/riscv/Kconfig"
osource "/home/raul/zephyr-course/zephyr/arch/posix/Kconfig"
osource "/home/raul/zephyr-course/zephyr/arch/openrisc/Kconfig"
osource "/home/raul/zephyr-course/zephyr/arch/mips/Kconfig"
osource "/home/raul/zephyr-course/zephyr/arch/arm64/Kconfig"
osource "/home/raul/zephyr-course/zephyr/arch/arm/Kconfig"
osource "/home/raul/zephyr-course/zephyr/arch/arc/Kconfig"
```

## twister-out/native_sim_native/host_gnu/tests/ring_buf/homework.unit.ring_buf/Kconfig/boards/Kconfig.defconfig
```kconfig
# Load Zephyr board defconfig descriptions.
osource "/home/raul/zephyr-course/zephyr/boards/native/native_sim/Kconfig.defconfig"
```

## twister-out/native_sim_native/host_gnu/tests/ring_buf/homework.unit.ring_buf/Kconfig/boards/Kconfig.native_sim
```kconfig
# Load board Kconfig descriptions.
osource "/home/raul/zephyr-course/zephyr/boards/native/native_sim/Kconfig.native_sim"
```

## twister-out/native_sim_native/host_gnu/tests/ring_buf/homework.unit.ring_buf/Kconfig/soc/Kconfig
```kconfig
# Load Zephyr SoC Kconfig descriptions.
osource "/home/raul/zephyr-course/zephyr/soc/xlnx/zynqmp/Kconfig"
osource "/home/raul/zephyr-course/zephyr/soc/xlnx/zynq7000/Kconfig"
osource "/home/raul/zephyr-course/zephyr/soc/xlnx/versalnet/Kconfig"
osource "/home/raul/zephyr-course/zephyr/soc/xlnx/versal2/Kconfig"
osource "/home/raul/zephyr-course/zephyr/soc/xlnx/versal/Kconfig"
osource "/home/raul/zephyr-course/zephyr/soc/xen/Kconfig"
osource "/home/raul/zephyr-course/zephyr/soc/wch/ch32v/Kconfig"
osource "/home/raul/zephyr-course/zephyr/soc/ti/tiva_c/Kconfig"
osource "/home/raul/zephyr-course/zephyr/soc/ti/simplelink/Kconfig"
osource "/home/raul/zephyr-course/zephyr/soc/ti/mspm/Kconfig"
osource "/home/raul/zephyr-course/zephyr/soc/ti/lm3s6965/Kconfig"
osource "/home/raul/zephyr-course/zephyr/soc/ti/k3/Kconfig"
osource "/home/raul/zephyr-course/zephyr/soc/ti/am13/Kconfig"
osource "/home/raul/zephyr-course/zephyr/soc/telink/tlsr/Kconfig"
osource "/home/raul/zephyr-course/zephyr/soc/syna/sr100/Kconfig"
osource "/home/raul/zephyr-course/zephyr/soc/starfive/jh71xx/Kconfig"
osource "/home/raul/zephyr-course/zephyr/soc/st/stm32/Kconfig"
osource "/home/raul/zephyr-course/zephyr/soc/snps/qemu_arc/Kconfig"
osource "/home/raul/zephyr-course/zephyr/soc/snps/nsim/arc_v/Kconfig"
osource "/home/raul/zephyr-course/zephyr/soc/snps/nsim/arc_classic/Kconfig"
osource "/home/raul/zephyr-course/zephyr/soc/snps/hsdk4xd/Kconfig"
osource "/home/raul/zephyr-course/zephyr/soc/snps/hsdk/Kconfig"
osource "/home/raul/zephyr-course/zephyr/soc/snps/emsk/Kconfig"
osource "/home/raul/zephyr-course/zephyr/soc/snps/emsdp/Kconfig"
osource "/home/raul/zephyr-course/zephyr/soc/snps/arc_iot/Kconfig"
osource "/home/raul/zephyr-course/zephyr/soc/silabs/Kconfig"
osource "/home/raul/zephyr-course/zephyr/soc/sifli/sf32/Kconfig"
osource "/home/raul/zephyr-course/zephyr/soc/sifive/sifive_freedom/Kconfig"
osource "/home/raul/zephyr-course/zephyr/soc/shakti/Kconfig"
osource "/home/raul/zephyr-course/zephyr/soc/sensry/Kconfig"
osource "/home/raul/zephyr-course/zephyr/soc/rockchip/Kconfig"
osource "/home/raul/zephyr-course/zephyr/soc/renode/riscv_virtual/Kconfig"
osource "/home/raul/zephyr-course/zephyr/soc/renode/cortex_r8_virtual/Kconfig"
osource "/home/raul/zephyr-course/zephyr/soc/renesas/smartbond/Kconfig"
osource "/home/raul/zephyr-course/zephyr/soc/renesas/rz/Kconfig"
osource "/home/raul/zephyr-course/zephyr/soc/renesas/rx/Kconfig"
osource "/home/raul/zephyr-course/zephyr/soc/renesas/rcar/Kconfig"
osource "/home/raul/zephyr-course/zephyr/soc/renesas/ra/Kconfig"
osource "/home/raul/zephyr-course/zephyr/soc/realtek/fingerprint/Kconfig"
osource "/home/raul/zephyr-course/zephyr/soc/realtek/ec/Kconfig"
osource "/home/raul/zephyr-course/zephyr/soc/realtek/bee/Kconfig"
osource "/home/raul/zephyr-course/zephyr/soc/realtek/ameba/Kconfig"
osource "/home/raul/zephyr-course/zephyr/soc/raspberrypi/rpi_pico/Kconfig"
osource "/home/raul/zephyr-course/zephyr/soc/quicklogic/eos_s3/Kconfig"
osource "/home/raul/zephyr-course/zephyr/soc/qemu/virt_riscv/Kconfig"
osource "/home/raul/zephyr-course/zephyr/soc/qemu/tricore/Kconfig"
osource "/home/raul/zephyr-course/zephyr/soc/qemu/or1k/Kconfig"
osource "/home/raul/zephyr-course/zephyr/soc/qemu/malta/Kconfig"
osource "/home/raul/zephyr-course/zephyr/soc/qemu/hexagon/Kconfig"
osource "/home/raul/zephyr-course/zephyr/soc/openisa/rv32m1/Kconfig"
osource "/home/raul/zephyr-course/zephyr/soc/openhwgroup/erbium/Kconfig"
osource "/home/raul/zephyr-course/zephyr/soc/openhwgroup/cva6/Kconfig"
osource "/home/raul/zephyr-course/zephyr/soc/oct/osd32mp15x/Kconfig"
osource "/home/raul/zephyr-course/zephyr/soc/nxp/s32/Kconfig"
osource "/home/raul/zephyr-course/zephyr/soc/nxp/rw/Kconfig"
osource "/home/raul/zephyr-course/zephyr/soc/nxp/mcx/Kconfig"
osource "/home/raul/zephyr-course/zephyr/soc/nxp/lpc/Kconfig"
osource "/home/raul/zephyr-course/zephyr/soc/nxp/layerscape/Kconfig"
osource "/home/raul/zephyr-course/zephyr/soc/nxp/kinetis/Kconfig"
osource "/home/raul/zephyr-course/zephyr/soc/nxp/imxrt/Kconfig"
osource "/home/raul/zephyr-course/zephyr/soc/nxp/imx/Kconfig"
osource "/home/raul/zephyr-course/zephyr/soc/nuvoton/numicro/Kconfig"
osource "/home/raul/zephyr-course/zephyr/soc/nuvoton/numaker/Kconfig"
osource "/home/raul/zephyr-course/zephyr/soc/nuvoton/npcx/Kconfig"
osource "/home/raul/zephyr-course/zephyr/soc/nuvoton/npcm/Kconfig"
osource "/home/raul/zephyr-course/zephyr/soc/nordic/Kconfig"
osource "/home/raul/zephyr-course/zephyr/soc/neorv32/Kconfig"
osource "/home/raul/zephyr-course/zephyr/soc/native/inf_clock/Kconfig"
osource "/home/raul/zephyr-course/zephyr/soc/microchip/smartfusion2/Kconfig"
osource "/home/raul/zephyr-course/zephyr/soc/microchip/sam/sama7/Kconfig"
osource "/home/raul/zephyr-course/zephyr/soc/microchip/sam/sama5/Kconfig"
osource "/home/raul/zephyr-course/zephyr/soc/microchip/sam/sam_d5x_e5x/Kconfig"
osource "/home/raul/zephyr-course/zephyr/soc/microchip/pic64/Kconfig"
osource "/home/raul/zephyr-course/zephyr/soc/microchip/pic32c/pic32cz_ca/Kconfig"
osource "/home/raul/zephyr-course/zephyr/soc/microchip/pic32c/pic32cx_sg/Kconfig"
osource "/home/raul/zephyr-course/zephyr/soc/microchip/pic32c/pic32cm_sg_gc/Kconfig"
osource "/home/raul/zephyr-course/zephyr/soc/microchip/pic32c/pic32cm_pl/Kconfig"
osource "/home/raul/zephyr-course/zephyr/soc/microchip/pic32c/pic32cm_jh/Kconfig"
osource "/home/raul/zephyr-course/zephyr/soc/microchip/pic32c/pic32ck_sg_gc/Kconfig"
osource "/home/raul/zephyr-course/zephyr/soc/microchip/miv/Kconfig"
osource "/home/raul/zephyr-course/zephyr/soc/microchip/mec/Kconfig"
osource "/home/raul/zephyr-course/zephyr/soc/mediatek/mt8xxx/Kconfig"
osource "/home/raul/zephyr-course/zephyr/soc/lowrisc/opentitan/Kconfig"
osource "/home/raul/zephyr-course/zephyr/soc/litex/Kconfig"
osource "/home/raul/zephyr-course/zephyr/soc/ite/ec/Kconfig"
osource "/home/raul/zephyr-course/zephyr/soc/intel/wildcat_lake/Kconfig"
osource "/home/raul/zephyr-course/zephyr/soc/intel/raptor_lake/Kconfig"
osource "/home/raul/zephyr-course/zephyr/soc/intel/panther_lake/Kconfig"
osource "/home/raul/zephyr-course/zephyr/soc/intel/nova_lake/Kconfig"
osource "/home/raul/zephyr-course/zephyr/soc/intel/lakemont/Kconfig"
osource "/home/raul/zephyr-course/zephyr/soc/intel/intel_socfpga_std/Kconfig"
osource "/home/raul/zephyr-course/zephyr/soc/intel/intel_socfpga/Kconfig"
osource "/home/raul/zephyr-course/zephyr/soc/intel/intel_niosv/Kconfig"
osource "/home/raul/zephyr-course/zephyr/soc/intel/intel_ish/Kconfig"
osource "/home/raul/zephyr-course/zephyr/soc/intel/intel_adsp/Kconfig"
osource "/home/raul/zephyr-course/zephyr/soc/intel/elkhart_lake/Kconfig"
osource "/home/raul/zephyr-course/zephyr/soc/intel/atom/Kconfig"
osource "/home/raul/zephyr-course/zephyr/soc/intel/apollo_lake/Kconfig"
osource "/home/raul/zephyr-course/zephyr/soc/intel/alder_lake/Kconfig"
osource "/home/raul/zephyr-course/zephyr/soc/infineon/psoc4/Kconfig"
osource "/home/raul/zephyr-course/zephyr/soc/infineon/edge/Kconfig"
osource "/home/raul/zephyr-course/zephyr/soc/infineon/cat3/Kconfig"
osource "/home/raul/zephyr-course/zephyr/soc/infineon/cat1c/Kconfig"
osource "/home/raul/zephyr-course/zephyr/soc/infineon/cat1b/Kconfig"
osource "/home/raul/zephyr-course/zephyr/soc/infineon/cat1a/Kconfig"
osource "/home/raul/zephyr-course/zephyr/soc/gd/gd32/Kconfig"
osource "/home/raul/zephyr-course/zephyr/soc/gaisler/leon3/Kconfig"
osource "/home/raul/zephyr-course/zephyr/soc/gaisler/gr716a/Kconfig"
osource "/home/raul/zephyr-course/zephyr/soc/focaltech/Kconfig"
osource "/home/raul/zephyr-course/zephyr/soc/espressif/Kconfig"
osource "/home/raul/zephyr-course/zephyr/soc/ene/kb1200/Kconfig"
osource "/home/raul/zephyr-course/zephyr/soc/ene/kb106x/Kconfig"
osource "/home/raul/zephyr-course/zephyr/soc/elan/em32f967/Kconfig"
osource "/home/raul/zephyr-course/zephyr/soc/egis/Kconfig"
osource "/home/raul/zephyr-course/zephyr/soc/efinix/sapphire/Kconfig"
osource "/home/raul/zephyr-course/zephyr/soc/cdns/xtensa_sample_controller/Kconfig"
osource "/home/raul/zephyr-course/zephyr/soc/cdns/swerv/Kconfig"
osource "/home/raul/zephyr-course/zephyr/soc/cdns/sample_controller32/Kconfig"
osource "/home/raul/zephyr-course/zephyr/soc/cdns/dc233c/Kconfig"
osource "/home/raul/zephyr-course/zephyr/soc/cdac/Kconfig"
osource "/home/raul/zephyr-course/zephyr/soc/brcm/bcmvk/Kconfig"
osource "/home/raul/zephyr-course/zephyr/soc/brcm/bcm2712/Kconfig"
osource "/home/raul/zephyr-course/zephyr/soc/brcm/bcm2711/Kconfig"
osource "/home/raul/zephyr-course/zephyr/soc/brcm/bcm2710/Kconfig"
osource "/home/raul/zephyr-course/zephyr/soc/blackberry/qnxhv_vm/Kconfig"
osource "/home/raul/zephyr-course/zephyr/soc/bflb/Kconfig"
osource "/home/raul/zephyr-course/zephyr/soc/atmel/sam0/Kconfig"
osource "/home/raul/zephyr-course/zephyr/soc/atmel/sam/Kconfig"
osource "/home/raul/zephyr-course/zephyr/soc/aspeed/Kconfig"
osource "/home/raul/zephyr-course/zephyr/soc/arm/Kconfig"
osource "/home/raul/zephyr-course/zephyr/soc/antmicro/myra/Kconfig"
osource "/home/raul/zephyr-course/zephyr/soc/andestech/Kconfig"
osource "/home/raul/zephyr-course/zephyr/soc/amd/acp_7_x/Kconfig"
osource "/home/raul/zephyr-course/zephyr/soc/amd/acp_7_0/Kconfig"
osource "/home/raul/zephyr-course/zephyr/soc/amd/acp_6_0/Kconfig"
osource "/home/raul/zephyr-course/zephyr/soc/ambiq/Kconfig"
osource "/home/raul/zephyr-course/zephyr/soc/allwinner/sun8i_h3/Kconfig"
osource "/home/raul/zephyr-course/zephyr/soc/allwinner/sun50i_h618/Kconfig"
osource "/home/raul/zephyr-course/zephyr/soc/alif/ensemble/Kconfig"
osource "/home/raul/zephyr-course/zephyr/soc/alif/balletto/Kconfig"
osource "/home/raul/zephyr-course/zephyr/soc/aesc/Kconfig"
osource "/home/raul/zephyr-course/zephyr/soc/adi/max32/Kconfig"
```
